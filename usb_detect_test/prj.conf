## CMakeLists.txt
```
cmake_minimum_required(VERSION 3.20.0)
find_package(Zephyr REQUIRED HINTS $ENV{ZEPHYR_BASE})

project(usb_detetct_test)

target_sources(app PRIVATE src/main.c)
```

## prj.conf
```kconfig
# USB Device support
CONFIG_USB_DEVICE_STACK=y
CONFIG_USB_DEVICE_PRODUCT="USB Detection Demo"
CONFIG_USB_DEVICE_MANUFACTURER="Your Company"
CONFIG_USB_DEVICE_VID=0x2fe3
CONFIG_USB_DEVICE_PID=0x0100

# Enable USB CDC ACM (optional - for serial communication)
CONFIG_USB_CDC_ACM=y
CONFIG_SERIAL=y
CONFIG_UART_INTERRUPT_DRIVEN=y
CONFIG_UART_LINE_CTRL=y

# Enable logging
CONFIG_LOG=y
CONFIG_USB_DEVICE_LOG_LEVEL_INF=y

# Enable console over USB (optional)
CONFIG_CONSOLE=y
CONFIG_UART_CONSOLE=y
```

## src/main.c
```c
#include <zephyr/usb/usb_device.h>
#include <zephyr/logging/log.h>

LOG_MODULE_REGISTER(usb_status, LOG_LEVEL_INF);

static void usb_status_callback(enum usb_dc_status_code status, const uint8_t *param)
{
    switch (status) {
    case USB_DC_CONNECTED:
        LOG_INF("USB connected to host");
        break;
    case USB_DC_DISCONNECTED:
        LOG_INF("USB disconnected from host");
        break;
    case USB_DC_SUSPEND:
        LOG_INF("USB suspended");
        break;
    case USB_DC_RESUME:
        LOG_INF("USB resumed");
        break;
    default:
        break;
    }
}

void main(void)
{
    int ret;

    ret = usb_enable(usb_status_callback);
    if (ret != 0) {
        LOG_ERR("Failed to enable USB");
        return;
    }
}
```
